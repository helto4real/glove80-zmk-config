
/*
 * Copyright (c) 2020 The ZMK Contributors
 * Copyright (c) 2023 Innaworks Development Limited, trading as MoErgo
 *
 * SPDX-License-Identifier: MIT
 */


/* THIS FILE WAS GENERATED BY GLOVE80 LAYOUT EDITOR
 *
 * This file was generated automatically. You may or may not want to
 * edit it directly.
 */

#include <behaviors.dtsi>
/* Include all behavior includes needed */
#include <dt-bindings/zmk/outputs.h>
#include <dt-bindings/zmk/keys.h>
#include <dt-bindings/zmk/bt.h>
#include <dt-bindings/zmk/rgb.h>

/* Automatically generated layer name #define */
#define LAYER_QWERTY 0
#define LAYER_Engrammer 1
#define LAYER_Engram 2
#define LAYER_Dvorak 3
#define LAYER_ColemakDHm 4
#define LAYER_Colemak 5
#define LAYER_Norman 6
#define LAYER_Workman 7
#define LAYER_Halmak 8
#define LAYER_Typing 9
#define LAYER_LeftPinky 10
#define LAYER_LeftRing1 11
#define LAYER_LeftRing2 12
#define LAYER_LeftMiddy 13
#define LAYER_LeftIndex 14
#define LAYER_RightPinky 15
#define LAYER_RightRing1 16
#define LAYER_RightRing2 17
#define LAYER_RightMiddy 18
#define LAYER_RightIndex 19
#define LAYER_Cursor 20
#define LAYER_Number 21
#define LAYER_Function 22
#define LAYER_Emoji 23
#define LAYER_Symbol 24
#define LAYER_Mouse 25
#define LAYER_System 26
#define LAYER_World 27
#define LAYER_Gaming 28
#define LAYER_Factory 29
#define LAYER_Lower 30
#define LAYER_Magic 31

/* To deal with the situation where there is no Lower layer, to keep &lower happy */
#ifndef LAYER_Lower
#define LAYER_Lower 0
#endif

/* Custom Device-tree */



/* Glove80 system behavior & macros */
/ {
    behaviors {
        // For the "layer" key, it'd nice to be able to use it as either a shift or a toggle.
        // Configure it as a tap dance, so the first tap (or hold) is a &mo and the second tap is a &to
        lower: lower {
            compatible = "zmk,behavior-tap-dance";
            label = "LAYER_TAP_DANCE";
            #binding-cells = <0>;
            tapping-term-ms = <200>;
            bindings = <&mo LAYER_Lower>, <&to LAYER_Lower>;
        };
    };
};

/ {
    macros {
        rgb_ug_status_macro: rgb_ug_status_macro {
            label = "RGB_UG_STATUS";
            compatible = "zmk,behavior-macro";
            #binding-cells = <0>;
            bindings
                = <&rgb_ug RGB_STATUS>;
        };
    };
};


/ {
#ifdef BT_DISC_CMD
    behaviors {
        bt_0: bt_0 {
            compatible = "zmk,behavior-tap-dance";
            label = "BT_0";
            #binding-cells = <0>;
            tapping-term-ms = <200>;
            bindings = <&bt_select_0>, <&bt BT_DISC 0>;
        };
        bt_1: bt_1 {
            compatible = "zmk,behavior-tap-dance";
            label = "BT_1";
            #binding-cells = <0>;
            tapping-term-ms = <200>;
            bindings = <&bt_select_1>, <&bt BT_DISC 1>;
        };
        bt_2: bt_2 {
            compatible = "zmk,behavior-tap-dance";
            label = "BT_2";
            #binding-cells = <0>;
            tapping-term-ms = <200>;
            bindings = <&bt_select_2>, <&bt BT_DISC 2>;
        };
        bt_3: bt_3 {
            compatible = "zmk,behavior-tap-dance";
            label = "BT_3";
            #binding-cells = <0>;
            tapping-term-ms = <200>;
            bindings = <&bt_select_3>, <&bt BT_DISC 3>;
        };
    };
    macros {
        bt_select_0: bt_select_0 {
            label = "BT_SELECT_0";
            compatible = "zmk,behavior-macro";
            #binding-cells = <0>;
            bindings
                = <&out OUT_BLE>,
                  <&bt BT_SEL 0>;
        };
        bt_select_1: bt_select_1 {
            label = "BT_SELECT_1";
            compatible = "zmk,behavior-macro";
            #binding-cells = <0>;
            bindings
                = <&out OUT_BLE>,
                  <&bt BT_SEL 1>;
        };
        bt_select_2: bt_select_2 {
            label = "BT_SELECT_2";
            compatible = "zmk,behavior-macro";
            #binding-cells = <0>;
            bindings
                = <&out OUT_BLE>,
                  <&bt BT_SEL 2>;
        };
        bt_select_3: bt_select_3 {
            label = "BT_SELECT_3";
            compatible = "zmk,behavior-macro";
            #binding-cells = <0>;
            bindings
                = <&out OUT_BLE>,
                  <&bt BT_SEL 3>;
        };
    };
#else
    macros {
        bt_0: bt_0 {
            label = "BT_0";
            compatible = "zmk,behavior-macro";
            #binding-cells = <0>;
            bindings
                = <&out OUT_BLE>,
                  <&bt BT_SEL 0>;
        };
        bt_1: bt_1 {
            label = "BT_1";
            compatible = "zmk,behavior-macro";
            #binding-cells = <0>;
            bindings
                = <&out OUT_BLE>,
                  <&bt BT_SEL 1>;
        };
        bt_2: bt_2 {
            label = "BT_2";
            compatible = "zmk,behavior-macro";
            #binding-cells = <0>;
            bindings
                = <&out OUT_BLE>,
                  <&bt BT_SEL 2>;
        };
        bt_3: bt_3 {
            label = "BT_3";
            compatible = "zmk,behavior-macro";
            #binding-cells = <0>;
            bindings
                = <&out OUT_BLE>,
                  <&bt BT_SEL 3>;
        };
    };
#endif
};

/ {
    behaviors {
        magic: magic {
            compatible = "zmk,behavior-hold-tap";
            label = "MAGIC_HOLD_TAP";
            #binding-cells = <2>;
            flavor = "tap-preferred";
            tapping-term-ms = <200>;
            bindings = <&mo>, <&rgb_ug_status_macro>;
        };
    };
};

/* #define for key positions */
#define POS_LH_T1 52
#define POS_LH_T2 53
#define POS_LH_T3 54
#define POS_LH_T4 69
#define POS_LH_T5 70
#define POS_LH_T6 71
#define POS_LH_C1R2 15
#define POS_LH_C1R3 27
#define POS_LH_C1R4 39
#define POS_LH_C1R5 51
#define POS_LH_C2R1 4
#define POS_LH_C2R2 14
#define POS_LH_C2R3 26
#define POS_LH_C2R4 38
#define POS_LH_C2R5 50
#define POS_LH_C2R6 68
#define POS_LH_C3R1 3
#define POS_LH_C3R2 13
#define POS_LH_C3R3 25
#define POS_LH_C3R4 37
#define POS_LH_C3R5 49
#define POS_LH_C3R6 67
#define POS_LH_C4R1 2
#define POS_LH_C4R2 12
#define POS_LH_C4R3 24
#define POS_LH_C4R4 36
#define POS_LH_C4R5 48
#define POS_LH_C4R6 66
#define POS_LH_C5R1 1
#define POS_LH_C5R2 11
#define POS_LH_C5R3 23
#define POS_LH_C5R4 35
#define POS_LH_C5R5 47
#define POS_LH_C5R6 65
#define POS_LH_C6R1 0
#define POS_LH_C6R2 10
#define POS_LH_C6R3 22
#define POS_LH_C6R4 34
#define POS_LH_C6R5 46
#define POS_LH_C6R6 64
#define POS_RH_T1 57
#define POS_RH_T2 56
#define POS_RH_T3 55
#define POS_RH_T4 74
#define POS_RH_T5 73
#define POS_RH_T6 72
#define POS_RH_C1R2 16
#define POS_RH_C1R3 28
#define POS_RH_C1R4 40
#define POS_RH_C1R5 58
#define POS_RH_C2R1 5
#define POS_RH_C2R2 17
#define POS_RH_C2R3 29
#define POS_RH_C2R4 41
#define POS_RH_C2R5 59
#define POS_RH_C2R6 75
#define POS_RH_C3R1 6
#define POS_RH_C3R2 18
#define POS_RH_C3R3 30
#define POS_RH_C3R4 42
#define POS_RH_C3R5 60
#define POS_RH_C3R6 76
#define POS_RH_C4R1 7
#define POS_RH_C4R2 19
#define POS_RH_C4R3 31
#define POS_RH_C4R4 43
#define POS_RH_C4R5 61
#define POS_RH_C4R6 77
#define POS_RH_C5R1 8
#define POS_RH_C5R2 20
#define POS_RH_C5R3 32
#define POS_RH_C5R4 44
#define POS_RH_C5R5 62
#define POS_RH_C5R6 78
#define POS_RH_C6R1 9
#define POS_RH_C6R2 21
#define POS_RH_C6R3 33
#define POS_RH_C6R4 45
#define POS_RH_C6R5 63
#define POS_RH_C6R6 79

/* Custom Defined Behaviors */
/ {

#include "engrammer.dtsi"
#include "helto.dtsi"
// NOTE: Use the many #define settings below to customize this keymap!
/*HACK*//{

};

/* Automatically generated macro definitions */
/ {
    macros {
    
    };
};

/* Automatically generated combos definitions */
/ {
    combos {
            compatible = "zmk,combos";
    };
};

/* Automatically generated keymap */
/ {
    keymap {
        compatible = "zmk,keymap";


        layer_QWERTY {
            bindings = <
                       &kp F1                        &kp F2                        &kp F3                        &kp F4                        &kp F5                                                                                                                                                                                                                &kp F6                         &kp F7                         &kp F8                             &kp F9                       &kp F10
                    &kp EQUAL                        &kp N1                        &kp N2                        &kp N3                        &kp N4                 &kp N5                                                                                                                                                   &kp N6                                &kp N7                         &kp N8                         &kp N9                             &kp N0                      &kp BSLH
                    &kp GRAVE                         &kp Q  &LeftRing2 (W, LAYER_QWERTY)                         &kp E                         &kp R                  &kp T                                                                                                                                                    &kp Y                                 &kp U                          &kp I  &RightRing2 (O, LAYER_QWERTY)                              &kp P                      &kp LBKT
                   &caps_word  &LeftPinky (A, LAYER_QWERTY)  &LeftRing1 (S, LAYER_QWERTY)  &LeftMiddy (D, LAYER_QWERTY)  &LeftIndex (F, LAYER_QWERTY)  &plain LAYER_Typing G                                                                                                                                    &plain LAYER_Typing H         &RightIndex (J, LAYER_QWERTY)  &RightMiddy (K, LAYER_QWERTY)  &RightRing1 (L, LAYER_QWERTY)  &RightPinky (SV_OE, LAYER_QWERTY)                       &kp SQT
 &sticky_key_modtap LSFT LSFT                         &kp Z                         &kp X                         &kp C                         &kp V                  &kp B      &thumb LAYER_Function ESC                      &kp UP  &kp DOWN  &kp LEFT               &kp RIGHT  &thumb LAYER_System ENTER                  &kp N                                 &kp M                      &kp COMMA                        &kp DOT                           &kp FSLH  &sticky_key_modtap RSFT RSFT
         &magic LAYER_Magic 0                      &kp HOME                     &kp PG_UP                     &kp PG_DN        &thumb LAYER_Emoji END                         &thumb LAYER_Cursor BACKSPACE  &thumb LAYER_Number DELETE    &lower    &lower  &thumb LAYER_Mouse TAB  &space LAYER_Symbol SPACE                         &thumb_parang_left LAYER_World _LPAR                  &left_bracket                 &right_bracket                      &parang_right          &magic LAYER_Magic 0
            >;
        };

        layer_Engrammer {
            bindings = <
               &kp F1                           &kp F2                           &kp F3                           &kp F4                           &kp F5                                                                                                                                                                                                                                                                        &kp F6                            &kp F7                            &kp F8                            &kp F9               &kp F10
            &kp EQUAL                           &kp N1                           &kp N2                           &kp N3                           &kp N4                     &kp N5                                                                                                                                                                                                           &kp N6                            &kp N7                            &kp N8                            &kp N9                            &kp N0              &kp BSLH
            &kp GRAVE                            &kp B  &LeftRing2 (Y, LAYER_Engrammer)                            &kp O                            &kp U                    &kp SQT                                                                                                                                                                                                         &kp SEMI                             &kp L                             &kp D  &RightRing2 (W, LAYER_Engrammer)                             &kp V                 &kp Z
           &caps_word  &LeftPinky (C, LAYER_Engrammer)  &LeftRing1 (I, LAYER_Engrammer)  &LeftMiddy (E, LAYER_Engrammer)  &LeftIndex (A, LAYER_Engrammer)  &plain LAYER_Typing COMMA                                                                                                                                                                                          &plain LAYER_Typing DOT  &RightIndex (H, LAYER_Engrammer)  &RightMiddy (T, LAYER_Engrammer)  &RightRing1 (S, LAYER_Engrammer)  &RightPinky (N, LAYER_Engrammer)                 &kp Q
            &kp LSHFT                            &kp G                            &kp X                            &kp J                            &kp K                  &kp MINUS      &thumb LAYER_Function ESC                      &kp UP                             &kp DOWN                             &kp LEFT               &kp RIGHT  &thumb LAYER_System ENTER                 &kp FSLH                             &kp R                             &kp M                             &kp F                             &kp P             &kp RSHFT
 &magic LAYER_Magic 0                         &kp HOME                        &kp PG_UP                        &kp PG_DN           &thumb LAYER_Emoji END                             &thumb LAYER_Cursor BACKSPACE  &thumb LAYER_Number DELETE  &thumb_lower_shift LAYER_Lower LSFT  &thumb_lower_shift LAYER_Lower LSFT  &thumb LAYER_Mouse TAB  &space LAYER_Symbol SPACE                           &thumb_parang_left LAYER_World 0                          &kp LBKT                          &kp RBKT                     &parang_right  &magic LAYER_Magic 0
            >;
        };

        layer_Engram {
            bindings = <
               &kp F1                        &kp F2                        &kp F3                        &kp F4                        &kp F5                                                                                                                                                                                                                                                                                          &kp F6                         &kp F7                         &kp F8                         &kp F9               &kp F10
             &kp LBKT                    &engram_N1                    &engram_N2                    &engram_N3                    &engram_N4                          &engram_N5                                                                                                                                                                                                                &engram_N6                        &engram_N7                     &engram_N8                     &engram_N9                     &engram_N0              &kp RBKT
           &engram_AT                         &kp B  &LeftRing2 (Y, LAYER_Engram)                         &kp O                         &kp U                         &engram_SQT                                                                                                                                                                                                               &engram_DQT                             &kp L                          &kp D  &RightRing2 (W, LAYER_Engram)                          &kp V                 &kp Z
           &caps_word  &LeftPinky (C, LAYER_Engram)  &LeftRing1 (I, LAYER_Engram)  &LeftMiddy (E, LAYER_Engram)  &LeftIndex (A, LAYER_Engram)  &plain_engram_COMMA LAYER_Typing 0                                                                                                                                                                                          &plain_engram_DOT LAYER_Typing 0     &RightIndex (H, LAYER_Engram)  &RightMiddy (T, LAYER_Engram)  &RightRing1 (S, LAYER_Engram)  &RightPinky (N, LAYER_Engram)                 &kp Q
            &kp LSHFT                         &kp G                         &kp X                         &kp J                         &kp K                           &kp MINUS      &thumb LAYER_Function ESC                      &kp UP                             &kp DOWN                             &kp LEFT               &kp RIGHT  &thumb LAYER_System ENTER                     &engram_QMARK                             &kp R                          &kp M                          &kp F                          &kp P             &kp RSHFT
 &magic LAYER_Magic 0                      &kp HOME                     &kp PG_UP                     &kp PG_DN        &thumb LAYER_Emoji END                                      &thumb LAYER_Cursor BACKSPACE  &thumb LAYER_Number DELETE  &thumb_lower_shift LAYER_Lower LSFT  &thumb_lower_shift LAYER_Lower LSFT  &thumb LAYER_Mouse TAB  &space LAYER_Symbol SPACE                                    &thumb_parang_left LAYER_World 0                   &engram_HASH                   &engram_FSLH                  &parang_right  &magic LAYER_Magic 0
            >;
        };

        layer_Dvorak {
            bindings = <
               &kp F1                        &kp F2                            &kp F3                        &kp F4                        &kp F5                                                                                                                                                                                                                                                                  &kp F6                         &kp F7                         &kp F8                         &kp F9               &kp F10
            &kp EQUAL                        &kp N1                            &kp N2                        &kp N3                        &kp N4                 &kp N5                                                                                                                                                                                                         &kp N6                            &kp N7                         &kp N8                         &kp N9                         &kp N0              &kp BSLH
            &kp GRAVE                       &kp SQT  &LeftRing2 (COMMA, LAYER_Dvorak)                       &kp DOT                         &kp P                  &kp Y                                                                                                                                                                                                          &kp F                             &kp G                          &kp C  &RightRing2 (R, LAYER_Dvorak)                          &kp L             &kp SLASH
           &caps_word  &LeftPinky (A, LAYER_Dvorak)      &LeftRing1 (O, LAYER_Dvorak)  &LeftMiddy (E, LAYER_Dvorak)  &LeftIndex (U, LAYER_Dvorak)  &plain LAYER_Typing I                                                                                                                                                                                          &plain LAYER_Typing D     &RightIndex (H, LAYER_Dvorak)  &RightMiddy (T, LAYER_Dvorak)  &RightRing1 (N, LAYER_Dvorak)  &RightPinky (S, LAYER_Dvorak)             &kp MINUS
            &kp LSHFT                      &kp SEMI                             &kp Q                         &kp J                         &kp K                  &kp X      &thumb LAYER_Function ESC                      &kp UP                             &kp DOWN                             &kp LEFT               &kp RIGHT  &thumb LAYER_System ENTER                  &kp B                             &kp M                          &kp W                          &kp V                          &kp Z             &kp RSHFT
 &magic LAYER_Magic 0                      &kp HOME                         &kp PG_UP                     &kp PG_DN        &thumb LAYER_Emoji END                         &thumb LAYER_Cursor BACKSPACE  &thumb LAYER_Number DELETE  &thumb_lower_shift LAYER_Lower LSFT  &thumb_lower_shift LAYER_Lower LSFT  &thumb LAYER_Mouse TAB  &space LAYER_Symbol SPACE                         &thumb_parang_left LAYER_World 0                       &kp LBKT                       &kp RBKT                  &parang_right  &magic LAYER_Magic 0
            >;
        };

        layer_ColemakDHm {
            bindings = <
               &kp F1                            &kp F2                            &kp F3                            &kp F4                            &kp F5                                                                                                                                                                                                                                                                   &kp F6                             &kp F7                             &kp F8                             &kp F9               &kp F10
            &kp EQUAL                            &kp N1                            &kp N2                            &kp N3                            &kp N4                 &kp N5                                                                                                                                                                                                         &kp N6                             &kp N7                             &kp N8                             &kp N9                             &kp N0              &kp BSLH
            &kp GRAVE                             &kp Q  &LeftRing2 (W, LAYER_ColemakDHm)                             &kp F                             &kp P                  &kp B                                                                                                                                                                                                          &kp J                              &kp L                              &kp U  &RightRing2 (Y, LAYER_ColemakDHm)                           &kp SEMI             &kp MINUS
           &caps_word  &LeftPinky (A, LAYER_ColemakDHm)  &LeftRing1 (R, LAYER_ColemakDHm)  &LeftMiddy (S, LAYER_ColemakDHm)  &LeftIndex (T, LAYER_ColemakDHm)  &plain LAYER_Typing G                                                                                                                                                                                          &plain LAYER_Typing M  &RightIndex (N, LAYER_ColemakDHm)  &RightMiddy (E, LAYER_ColemakDHm)  &RightRing1 (I, LAYER_ColemakDHm)  &RightPinky (O, LAYER_ColemakDHm)               &kp SQT
            &kp LSHFT                             &kp Z                             &kp X                             &kp C                             &kp D                  &kp V      &thumb LAYER_Function ESC                      &kp UP                             &kp DOWN                             &kp LEFT               &kp RIGHT  &thumb LAYER_System ENTER                  &kp K                              &kp H                          &kp COMMA                            &kp DOT                           &kp FSLH             &kp RSHFT
 &magic LAYER_Magic 0                          &kp HOME                         &kp PG_UP                         &kp PG_DN            &thumb LAYER_Emoji END                         &thumb LAYER_Cursor BACKSPACE  &thumb LAYER_Number DELETE  &thumb_lower_shift LAYER_Lower LSFT  &thumb_lower_shift LAYER_Lower LSFT  &thumb LAYER_Mouse TAB  &space LAYER_Symbol SPACE                          &thumb_parang_left LAYER_World 0                           &kp LBKT                           &kp RBKT                      &parang_right  &magic LAYER_Magic 0
            >;
        };

        layer_Colemak {
            bindings = <
               &kp F1                         &kp F2                         &kp F3                         &kp F4                         &kp F5                                                                                                                                                                                                                                                                  &kp F6                          &kp F7                          &kp F8                          &kp F9               &kp F10
            &kp EQUAL                         &kp N1                         &kp N2                         &kp N3                         &kp N4                 &kp N5                                                                                                                                                                                                         &kp N6                            &kp N7                          &kp N8                          &kp N9                          &kp N0              &kp BSLH
            &kp GRAVE                          &kp Q  &LeftRing2 (W, LAYER_Colemak)                          &kp F                          &kp P                  &kp G                                                                                                                                                                                                          &kp J                             &kp L                           &kp U  &RightRing2 (Y, LAYER_Colemak)                        &kp SEMI             &kp MINUS
           &caps_word  &LeftPinky (A, LAYER_Colemak)  &LeftRing1 (R, LAYER_Colemak)  &LeftMiddy (S, LAYER_Colemak)  &LeftIndex (T, LAYER_Colemak)  &plain LAYER_Typing D                                                                                                                                                                                          &plain LAYER_Typing H    &RightIndex (N, LAYER_Colemak)  &RightMiddy (E, LAYER_Colemak)  &RightRing1 (I, LAYER_Colemak)  &RightPinky (O, LAYER_Colemak)               &kp SQT
            &kp LSHFT                          &kp Z                          &kp X                          &kp C                          &kp V                  &kp B      &thumb LAYER_Function ESC                      &kp UP                             &kp DOWN                             &kp LEFT               &kp RIGHT  &thumb LAYER_System ENTER                  &kp K                             &kp M                       &kp COMMA                         &kp DOT                        &kp FSLH             &kp RSHFT
 &magic LAYER_Magic 0                       &kp HOME                      &kp PG_UP                      &kp PG_DN         &thumb LAYER_Emoji END                         &thumb LAYER_Cursor BACKSPACE  &thumb LAYER_Number DELETE  &thumb_lower_shift LAYER_Lower LSFT  &thumb_lower_shift LAYER_Lower LSFT  &thumb LAYER_Mouse TAB  &space LAYER_Symbol SPACE                         &thumb_parang_left LAYER_World 0                        &kp LBKT                        &kp RBKT                   &parang_right  &magic LAYER_Magic 0
            >;
        };

        layer_Norman {
            bindings = <
               &kp F1                        &kp F2                        &kp F3                        &kp F4                        &kp F5                                                                                                                                                                                                                                                                  &kp F6                         &kp F7                         &kp F8                         &kp F9               &kp F10
            &kp EQUAL                        &kp N1                        &kp N2                        &kp N3                        &kp N4                 &kp N5                                                                                                                                                                                                         &kp N6                            &kp N7                         &kp N8                         &kp N9                         &kp N0              &kp BSLH
            &kp GRAVE                         &kp Q  &LeftRing2 (W, LAYER_Norman)                         &kp D                         &kp F                  &kp K                                                                                                                                                                                                          &kp J                             &kp U                          &kp R  &RightRing2 (L, LAYER_Norman)                       &kp SEMI             &kp MINUS
           &caps_word  &LeftPinky (A, LAYER_Norman)  &LeftRing1 (S, LAYER_Norman)  &LeftMiddy (E, LAYER_Norman)  &LeftIndex (T, LAYER_Norman)  &plain LAYER_Typing G                                                                                                                                                                                          &plain LAYER_Typing Y     &RightIndex (N, LAYER_Norman)  &RightMiddy (I, LAYER_Norman)  &RightRing1 (O, LAYER_Norman)  &RightPinky (H, LAYER_Norman)               &kp SQT
            &kp LSHFT                         &kp Z                         &kp X                         &kp C                         &kp V                  &kp B      &thumb LAYER_Function ESC                      &kp UP                             &kp DOWN                             &kp LEFT               &kp RIGHT  &thumb LAYER_System ENTER                  &kp P                             &kp M                      &kp COMMA                        &kp DOT                       &kp FSLH             &kp RSHFT
 &magic LAYER_Magic 0                      &kp HOME                     &kp PG_UP                     &kp PG_DN        &thumb LAYER_Emoji END                         &thumb LAYER_Cursor BACKSPACE  &thumb LAYER_Number DELETE  &thumb_lower_shift LAYER_Lower LSFT  &thumb_lower_shift LAYER_Lower LSFT  &thumb LAYER_Mouse TAB  &space LAYER_Symbol SPACE                         &thumb_parang_left LAYER_World 0                       &kp LBKT                       &kp RBKT                  &parang_right  &magic LAYER_Magic 0
            >;
        };

        layer_Workman {
            bindings = <
               &kp F1                         &kp F2                         &kp F3                         &kp F4                         &kp F5                                                                                                                                                                                                                                                                  &kp F6                          &kp F7                          &kp F8                          &kp F9               &kp F10
            &kp EQUAL                         &kp N1                         &kp N2                         &kp N3                         &kp N4                 &kp N5                                                                                                                                                                                                         &kp N6                            &kp N7                          &kp N8                          &kp N9                          &kp N0              &kp BSLH
            &kp GRAVE                          &kp Q  &LeftRing2 (D, LAYER_Workman)                          &kp R                          &kp W                  &kp B                                                                                                                                                                                                          &kp J                             &kp F                           &kp U  &RightRing2 (P, LAYER_Workman)                        &kp SEMI             &kp MINUS
           &caps_word  &LeftPinky (A, LAYER_Workman)  &LeftRing1 (S, LAYER_Workman)  &LeftMiddy (H, LAYER_Workman)  &LeftIndex (T, LAYER_Workman)  &plain LAYER_Typing G                                                                                                                                                                                          &plain LAYER_Typing Y    &RightIndex (N, LAYER_Workman)  &RightMiddy (E, LAYER_Workman)  &RightRing1 (O, LAYER_Workman)  &RightPinky (I, LAYER_Workman)               &kp SQT
            &kp LSHFT                          &kp Z                          &kp X                          &kp M                          &kp C                  &kp V      &thumb LAYER_Function ESC                      &kp UP                             &kp DOWN                             &kp LEFT               &kp RIGHT  &thumb LAYER_System ENTER                  &kp K                             &kp L                       &kp COMMA                         &kp DOT                        &kp FSLH             &kp RSHFT
 &magic LAYER_Magic 0                       &kp HOME                      &kp PG_UP                      &kp PG_DN         &thumb LAYER_Emoji END                         &thumb LAYER_Cursor BACKSPACE  &thumb LAYER_Number DELETE  &thumb_lower_shift LAYER_Lower LSFT  &thumb_lower_shift LAYER_Lower LSFT  &thumb LAYER_Mouse TAB  &space LAYER_Symbol SPACE                         &thumb_parang_left LAYER_World 0                        &kp LBKT                        &kp RBKT                   &parang_right  &magic LAYER_Magic 0
            >;
        };

        layer_Halmak {
            bindings = <
               &kp F1                        &kp F2                        &kp F3                        &kp F4                        &kp F5                                                                                                                                                                                                                                                                        &kp F6                         &kp F7                         &kp F8                         &kp F9               &kp F10
            &kp EQUAL                        &kp N1                        &kp N2                        &kp N3                        &kp N4                     &kp N5                                                                                                                                                                                                           &kp N6                            &kp N7                         &kp N8                         &kp N9                         &kp N0              &kp BSLH
            &kp GRAVE                         &kp W  &LeftRing2 (L, LAYER_Halmak)                         &kp R                         &kp B                      &kp Z                                                                                                                                                                                                         &kp SEMI                             &kp Q                          &kp U  &RightRing2 (D, LAYER_Halmak)                          &kp J             &kp MINUS
           &caps_word  &LeftPinky (S, LAYER_Halmak)  &LeftRing1 (H, LAYER_Halmak)  &LeftMiddy (N, LAYER_Halmak)  &LeftIndex (T, LAYER_Halmak)  &plain LAYER_Typing COMMA                                                                                                                                                                                          &plain LAYER_Typing DOT     &RightIndex (A, LAYER_Halmak)  &RightMiddy (E, LAYER_Halmak)  &RightRing1 (O, LAYER_Halmak)  &RightPinky (I, LAYER_Halmak)               &kp SQT
            &kp LSHFT                         &kp F                         &kp M                         &kp V                         &kp C                   &kp FSLH      &thumb LAYER_Function ESC                      &kp UP                             &kp DOWN                             &kp LEFT               &kp RIGHT  &thumb LAYER_System ENTER                    &kp G                             &kp P                          &kp X                          &kp K                          &kp Y             &kp RSHFT
 &magic LAYER_Magic 0                      &kp HOME                     &kp PG_UP                     &kp PG_DN        &thumb LAYER_Emoji END                             &thumb LAYER_Cursor BACKSPACE  &thumb LAYER_Number DELETE  &thumb_lower_shift LAYER_Lower LSFT  &thumb_lower_shift LAYER_Lower LSFT  &thumb LAYER_Mouse TAB  &space LAYER_Symbol SPACE                           &thumb_parang_left LAYER_World 0                       &kp LBKT                       &kp RBKT                  &parang_right  &magic LAYER_Magic 0
            >;
        };

        layer_Typing {
            bindings = <
 &trans              &trans              &trans              &trans              &trans                                                                                                                                                &trans               &trans               &trans               &trans  &trans
 &trans              &trans              &trans              &trans              &trans         &trans                                                                                                            &trans               &trans               &trans               &trans               &trans  &trans
 &trans              &trans  &kp LEFT_RING2_KEY              &trans              &trans         &trans                                                                                                            &trans               &trans               &trans  &kp RIGHT_RING2_KEY               &trans  &trans
 &trans  &kp LEFT_PINKY_KEY  &kp LEFT_RING1_KEY  &kp LEFT_MIDDY_KEY  &kp LEFT_INDEX_KEY  &LeftPlainKey                                                                                                    &RightPlainKey  &kp RIGHT_INDEX_KEY  &kp RIGHT_MIDDY_KEY  &kp RIGHT_RING1_KEY  &kp RIGHT_PINKY_KEY  &trans
 &trans              &trans              &trans              &trans              &trans         &trans  &kp KEY_LH_T1         &trans             &trans             &trans         &trans  &kp KEY_RH_T1          &trans               &trans               &trans               &trans               &trans  &trans
 &trans              &trans              &trans              &trans              &trans                 &kp KEY_LH_T4  &kp KEY_LH_T5  &tog LAYER_Typing  &tog LAYER_Typing  &kp KEY_RH_T5  &kp KEY_RH_T4                               &trans               &trans               &trans               &trans  &trans
            >;
        };

        layer_LeftPinky {
            bindings = <
 &left_pinky_tap KEY_LH_C6R1  &left_pinky_tap KEY_LH_C5R1  &left_pinky_tap KEY_LH_C4R1  &left_pinky_tap KEY_LH_C3R1  &left_pinky_tap KEY_LH_C2R1                                                                                                            &trans               &trans               &trans               &trans  &trans
 &left_pinky_tap KEY_LH_C6R2  &left_pinky_tap KEY_LH_C5R2  &left_pinky_tap KEY_LH_C4R2  &left_pinky_tap KEY_LH_C3R2  &left_pinky_tap KEY_LH_C2R2  &left_pinky_tap KEY_LH_C1R2                                                          &trans               &trans               &trans               &trans               &trans  &trans
 &left_pinky_tap KEY_LH_C6R3  &left_pinky_tap KEY_LH_C5R3              &LeftPinkyRing2  &left_pinky_tap KEY_LH_C3R3  &left_pinky_tap KEY_LH_C2R3  &left_pinky_tap KEY_LH_C1R3                                                          &trans               &trans               &trans  &kp RIGHT_RING2_KEY               &trans  &trans
 &left_pinky_tap KEY_LH_C6R4                        &none              &LeftPinkyRing1              &LeftPinkyMiddy              &LeftPinkyIndex  &left_pinky_tap KEY_LH_C1R4                                                  &RightPlainKey  &kp RIGHT_INDEX_KEY  &kp RIGHT_MIDDY_KEY  &kp RIGHT_RING1_KEY  &kp RIGHT_PINKY_KEY  &trans
 &left_pinky_tap KEY_LH_C6R5  &left_pinky_tap KEY_LH_C5R5  &left_pinky_tap KEY_LH_C4R5  &left_pinky_tap KEY_LH_C3R5  &left_pinky_tap KEY_LH_C2R5  &left_pinky_tap KEY_LH_C1R5  &trans  &trans  &trans  &trans  &trans  &trans          &trans               &trans               &trans               &trans               &trans  &trans
                      &trans  &left_pinky_tap KEY_LH_C5R6  &left_pinky_tap KEY_LH_C4R6  &left_pinky_tap KEY_LH_C3R6  &left_pinky_tap KEY_LH_C2R6                               &trans  &trans  &trans  &trans  &trans  &trans                               &trans               &trans               &trans               &trans  &trans
            >;
        };

        layer_LeftRing1 {
            bindings = <
 &left_ring1_tap KEY_LH_C6R1  &left_ring1_tap KEY_LH_C5R1  &left_ring1_tap KEY_LH_C4R1  &left_ring1_tap KEY_LH_C3R1  &left_ring1_tap KEY_LH_C2R1                                                                                                            &trans               &trans               &trans               &trans  &trans
 &left_ring1_tap KEY_LH_C6R2  &left_ring1_tap KEY_LH_C5R2  &left_ring1_tap KEY_LH_C4R2  &left_ring1_tap KEY_LH_C3R2  &left_ring1_tap KEY_LH_C2R2  &left_ring1_tap KEY_LH_C1R2                                                          &trans               &trans               &trans               &trans               &trans  &trans
 &left_ring1_tap KEY_LH_C6R3  &left_ring1_tap KEY_LH_C5R3              &LeftRing1Ring2  &left_ring1_tap KEY_LH_C3R3  &left_ring1_tap KEY_LH_C2R3  &left_ring1_tap KEY_LH_C1R3                                                          &trans               &trans               &trans  &kp RIGHT_RING2_KEY               &trans  &trans
 &left_ring1_tap KEY_LH_C6R4              &LeftRing1Pinky                        &none              &LeftRing1Middy              &LeftRing1Index  &left_ring1_tap KEY_LH_C1R4                                                  &RightPlainKey  &kp RIGHT_INDEX_KEY  &kp RIGHT_MIDDY_KEY  &kp RIGHT_RING1_KEY  &kp RIGHT_PINKY_KEY  &trans
 &left_ring1_tap KEY_LH_C6R5  &left_ring1_tap KEY_LH_C5R5  &left_ring1_tap KEY_LH_C4R5  &left_ring1_tap KEY_LH_C3R5  &left_ring1_tap KEY_LH_C2R5  &left_ring1_tap KEY_LH_C1R5  &trans  &trans  &trans  &trans  &trans  &trans          &trans               &trans               &trans               &trans               &trans  &trans
                      &trans  &left_ring1_tap KEY_LH_C5R6  &left_ring1_tap KEY_LH_C4R6  &left_ring1_tap KEY_LH_C3R6  &left_ring1_tap KEY_LH_C2R6                               &trans  &trans  &trans  &trans  &trans  &trans                               &trans               &trans               &trans               &trans  &trans
            >;
        };

        layer_LeftRing2 {
            bindings = <
 &left_ring2_tap KEY_LH_C6R1  &left_ring2_tap KEY_LH_C5R1  &left_ring2_tap KEY_LH_C4R1  &left_ring2_tap KEY_LH_C3R1  &left_ring2_tap KEY_LH_C2R1                                                                                                            &trans               &trans               &trans               &trans  &trans
 &left_ring2_tap KEY_LH_C6R2  &left_ring2_tap KEY_LH_C5R2  &left_ring2_tap KEY_LH_C4R2  &left_ring2_tap KEY_LH_C3R2  &left_ring2_tap KEY_LH_C2R2  &left_ring2_tap KEY_LH_C1R2                                                          &trans               &trans               &trans               &trans               &trans  &trans
 &left_ring2_tap KEY_LH_C6R3  &left_ring2_tap KEY_LH_C5R3                        &none  &left_ring2_tap KEY_LH_C3R3  &left_ring2_tap KEY_LH_C2R3  &left_ring2_tap KEY_LH_C1R3                                                          &trans               &trans               &trans  &kp RIGHT_RING2_KEY               &trans  &trans
 &left_ring2_tap KEY_LH_C6R4              &LeftRing2Pinky              &LeftRing2Ring1              &LeftRing2Middy              &LeftRing2Index  &left_ring2_tap KEY_LH_C1R4                                                  &RightPlainKey  &kp RIGHT_INDEX_KEY  &kp RIGHT_MIDDY_KEY  &kp RIGHT_RING1_KEY  &kp RIGHT_PINKY_KEY  &trans
 &left_ring2_tap KEY_LH_C6R5  &left_ring2_tap KEY_LH_C5R5  &left_ring2_tap KEY_LH_C4R5  &left_ring2_tap KEY_LH_C3R5  &left_ring2_tap KEY_LH_C2R5  &left_ring2_tap KEY_LH_C1R5  &trans  &trans  &trans  &trans  &trans  &trans          &trans               &trans               &trans               &trans               &trans  &trans
                      &trans  &left_ring2_tap KEY_LH_C5R6  &left_ring2_tap KEY_LH_C4R6  &left_ring2_tap KEY_LH_C3R6  &left_ring2_tap KEY_LH_C2R6                               &trans  &trans  &trans  &trans  &trans  &trans                               &trans               &trans               &trans               &trans  &trans
            >;
        };

        layer_LeftMiddy {
            bindings = <
 &left_middy_tap KEY_LH_C6R1  &left_middy_tap KEY_LH_C5R1  &left_middy_tap KEY_LH_C4R1  &left_middy_tap KEY_LH_C3R1  &left_middy_tap KEY_LH_C2R1                                                                                                            &trans               &trans               &trans               &trans  &trans
 &left_middy_tap KEY_LH_C6R2  &left_middy_tap KEY_LH_C5R2  &left_middy_tap KEY_LH_C4R2  &left_middy_tap KEY_LH_C3R2  &left_middy_tap KEY_LH_C2R2  &left_middy_tap KEY_LH_C1R2                                                          &trans               &trans               &trans               &trans               &trans  &trans
 &left_middy_tap KEY_LH_C6R3  &left_middy_tap KEY_LH_C5R3              &LeftMiddyRing2  &left_middy_tap KEY_LH_C3R3  &left_middy_tap KEY_LH_C2R3  &left_middy_tap KEY_LH_C1R3                                                          &trans               &trans               &trans  &kp RIGHT_RING2_KEY               &trans  &trans
 &left_middy_tap KEY_LH_C6R4              &LeftMiddyPinky              &LeftMiddyRing1                        &none              &LeftMiddyIndex  &left_middy_tap KEY_LH_C1R4                                                  &RightPlainKey  &kp RIGHT_INDEX_KEY  &kp RIGHT_MIDDY_KEY  &kp RIGHT_RING1_KEY  &kp RIGHT_PINKY_KEY  &trans
 &left_middy_tap KEY_LH_C6R5  &left_middy_tap KEY_LH_C5R5  &left_middy_tap KEY_LH_C4R5  &left_middy_tap KEY_LH_C3R5  &left_middy_tap KEY_LH_C2R5  &left_middy_tap KEY_LH_C1R5  &trans  &trans  &trans  &trans  &trans  &trans          &trans               &trans               &trans               &trans               &trans  &trans
                      &trans  &left_middy_tap KEY_LH_C5R6  &left_middy_tap KEY_LH_C4R6  &left_middy_tap KEY_LH_C3R6  &left_middy_tap KEY_LH_C2R6                               &trans  &trans  &trans  &trans  &trans  &trans                               &trans               &trans               &trans               &trans  &trans
            >;
        };

        layer_LeftIndex {
            bindings = <
 &left_index_tap KEY_LH_C6R1  &left_index_tap KEY_LH_C5R1  &left_index_tap KEY_LH_C4R1  &left_index_tap KEY_LH_C3R1  &left_index_tap KEY_LH_C2R1                                                                                                            &trans               &trans               &trans               &trans  &trans
 &left_index_tap KEY_LH_C6R2  &left_index_tap KEY_LH_C5R2  &left_index_tap KEY_LH_C4R2  &left_index_tap KEY_LH_C3R2  &left_index_tap KEY_LH_C2R2  &left_index_tap KEY_LH_C1R2                                                          &trans               &trans               &trans               &trans               &trans  &trans
 &left_index_tap KEY_LH_C6R3  &left_index_tap KEY_LH_C5R3              &LeftIndexRing2  &left_index_tap KEY_LH_C3R3  &left_index_tap KEY_LH_C2R3  &left_index_tap KEY_LH_C1R3                                                          &trans               &trans               &trans  &kp RIGHT_RING2_KEY               &trans  &trans
 &left_index_tap KEY_LH_C6R4              &LeftIndexPinky              &LeftIndexRing1              &LeftIndexMiddy                        &none  &left_index_tap KEY_LH_C1R4                                                  &RightPlainKey  &kp RIGHT_INDEX_KEY  &kp RIGHT_MIDDY_KEY  &kp RIGHT_RING1_KEY  &kp RIGHT_PINKY_KEY  &trans
 &left_index_tap KEY_LH_C6R5  &left_index_tap KEY_LH_C5R5  &left_index_tap KEY_LH_C4R5  &left_index_tap KEY_LH_C3R5  &left_index_tap KEY_LH_C2R5  &left_index_tap KEY_LH_C1R5  &trans  &trans  &trans  &trans  &trans  &trans          &trans               &trans               &trans               &trans               &trans  &trans
                      &trans  &left_index_tap KEY_LH_C5R6  &left_index_tap KEY_LH_C4R6  &left_index_tap KEY_LH_C3R6  &left_index_tap KEY_LH_C2R6                               &trans  &trans  &trans  &trans  &trans  &trans                               &trans               &trans               &trans               &trans  &trans
            >;
        };

        layer_RightPinky {
            bindings = <
 &trans              &trans              &trans              &trans              &trans                                                                                               &right_pinky_tap KEY_RH_C2R1  &right_pinky_tap KEY_RH_C3R1  &right_pinky_tap KEY_RH_C4R1  &right_pinky_tap KEY_RH_C5R1  &right_pinky_tap KEY_RH_C6R1
 &trans              &trans              &trans              &trans              &trans         &trans                                                  &right_pinky_tap KEY_RH_C1R2  &right_pinky_tap KEY_RH_C2R2  &right_pinky_tap KEY_RH_C3R2  &right_pinky_tap KEY_RH_C4R2  &right_pinky_tap KEY_RH_C5R2  &right_pinky_tap KEY_RH_C6R2
 &trans              &trans  &kp LEFT_RING2_KEY              &trans              &trans         &trans                                                  &right_pinky_tap KEY_RH_C1R3  &right_pinky_tap KEY_RH_C2R3  &right_pinky_tap KEY_RH_C3R3              &RightPinkyRing2  &right_pinky_tap KEY_RH_C5R3  &right_pinky_tap KEY_RH_C6R3
 &trans  &kp LEFT_PINKY_KEY  &kp LEFT_RING1_KEY  &kp LEFT_MIDDY_KEY  &kp LEFT_INDEX_KEY  &LeftPlainKey                                                  &right_pinky_tap KEY_RH_C1R4              &RightPinkyIndex              &RightPinkyMiddy              &RightPinkyRing1                         &none  &right_pinky_tap KEY_RH_C6R4
 &trans              &trans              &trans              &trans              &trans         &trans  &trans  &trans  &trans  &trans  &trans  &trans  &right_pinky_tap KEY_RH_C1R5  &right_pinky_tap KEY_RH_C2R5  &right_pinky_tap KEY_RH_C3R5  &right_pinky_tap KEY_RH_C4R5  &right_pinky_tap KEY_RH_C5R5  &right_pinky_tap KEY_RH_C6R5
 &trans              &trans              &trans              &trans              &trans                 &trans  &trans  &trans  &trans  &trans  &trans                                &right_pinky_tap KEY_RH_C2R6  &right_pinky_tap KEY_RH_C3R6  &right_pinky_tap KEY_RH_C4R6  &right_pinky_tap KEY_RH_C5R6                        &trans
            >;
        };

        layer_RightRing1 {
            bindings = <
 &trans              &trans              &trans              &trans              &trans                                                                                               &right_ring1_tap KEY_RH_C2R1  &right_ring1_tap KEY_RH_C3R1  &right_ring1_tap KEY_RH_C4R1  &right_ring1_tap KEY_RH_C5R1  &right_ring1_tap KEY_RH_C6R1
 &trans              &trans              &trans              &trans              &trans         &trans                                                  &right_ring1_tap KEY_RH_C1R2  &right_ring1_tap KEY_RH_C2R2  &right_ring1_tap KEY_RH_C3R2  &right_ring1_tap KEY_RH_C4R2  &right_ring1_tap KEY_RH_C5R2  &right_ring1_tap KEY_RH_C6R2
 &trans              &trans  &kp LEFT_RING2_KEY              &trans              &trans         &trans                                                  &right_ring1_tap KEY_RH_C1R3  &right_ring1_tap KEY_RH_C2R3  &right_ring1_tap KEY_RH_C3R3              &RightRing1Ring2  &right_ring1_tap KEY_RH_C5R3  &right_ring1_tap KEY_RH_C6R3
 &trans  &kp LEFT_PINKY_KEY  &kp LEFT_RING1_KEY  &kp LEFT_MIDDY_KEY  &kp LEFT_INDEX_KEY  &LeftPlainKey                                                  &right_ring1_tap KEY_RH_C1R4              &RightRing1Index              &RightRing1Middy                         &none              &RightRing1Pinky  &right_ring1_tap KEY_RH_C6R4
 &trans              &trans              &trans              &trans              &trans         &trans  &trans  &trans  &trans  &trans  &trans  &trans  &right_ring1_tap KEY_RH_C1R5  &right_ring1_tap KEY_RH_C2R5  &right_ring1_tap KEY_RH_C3R5  &right_ring1_tap KEY_RH_C4R5  &right_ring1_tap KEY_RH_C5R5  &right_ring1_tap KEY_RH_C6R5
 &trans              &trans              &trans              &trans              &trans                 &trans  &trans  &trans  &trans  &trans  &trans                                &right_ring1_tap KEY_RH_C2R6  &right_ring1_tap KEY_RH_C3R6  &right_ring1_tap KEY_RH_C4R6  &right_ring1_tap KEY_RH_C5R6                        &trans
            >;
        };

        layer_RightRing2 {
            bindings = <
 &trans              &trans              &trans              &trans              &trans                                                                                               &right_ring2_tap KEY_RH_C2R1  &right_ring2_tap KEY_RH_C3R1  &right_ring2_tap KEY_RH_C4R1  &right_ring2_tap KEY_RH_C5R1  &right_ring2_tap KEY_RH_C6R1
 &trans              &trans              &trans              &trans              &trans         &trans                                                  &right_ring2_tap KEY_RH_C1R2  &right_ring2_tap KEY_RH_C2R2  &right_ring2_tap KEY_RH_C3R2  &right_ring2_tap KEY_RH_C4R2  &right_ring2_tap KEY_RH_C5R2  &right_ring2_tap KEY_RH_C6R2
 &trans              &trans  &kp LEFT_RING2_KEY              &trans              &trans         &trans                                                  &right_ring2_tap KEY_RH_C1R3  &right_ring2_tap KEY_RH_C2R3  &right_ring2_tap KEY_RH_C3R3                         &none  &right_ring2_tap KEY_RH_C5R3  &right_ring2_tap KEY_RH_C6R3
 &trans  &kp LEFT_PINKY_KEY  &kp LEFT_RING1_KEY  &kp LEFT_MIDDY_KEY  &kp LEFT_INDEX_KEY  &LeftPlainKey                                                  &right_ring2_tap KEY_RH_C1R4              &RightRing2Index              &RightRing2Middy              &RightRing2Ring1              &RightRing2Pinky  &right_ring2_tap KEY_RH_C6R4
 &trans              &trans              &trans              &trans              &trans         &trans  &trans  &trans  &trans  &trans  &trans  &trans  &right_ring2_tap KEY_RH_C1R5  &right_ring2_tap KEY_RH_C2R5  &right_ring2_tap KEY_RH_C3R5  &right_ring2_tap KEY_RH_C4R5  &right_ring2_tap KEY_RH_C5R5  &right_ring2_tap KEY_RH_C6R5
 &trans              &trans              &trans              &trans              &trans                 &trans  &trans  &trans  &trans  &trans  &trans                                &right_ring2_tap KEY_RH_C2R6  &right_ring2_tap KEY_RH_C3R6  &right_ring2_tap KEY_RH_C4R6  &right_ring2_tap KEY_RH_C5R6                        &trans
            >;
        };

        layer_RightMiddy {
            bindings = <
 &trans              &trans              &trans              &trans              &trans                                                                                               &right_middy_tap KEY_RH_C2R1  &right_middy_tap KEY_RH_C3R1  &right_middy_tap KEY_RH_C4R1  &right_middy_tap KEY_RH_C5R1  &right_middy_tap KEY_RH_C6R1
 &trans              &trans              &trans              &trans              &trans         &trans                                                  &right_middy_tap KEY_RH_C1R2  &right_middy_tap KEY_RH_C2R2  &right_middy_tap KEY_RH_C3R2  &right_middy_tap KEY_RH_C4R2  &right_middy_tap KEY_RH_C5R2  &right_middy_tap KEY_RH_C6R2
 &trans              &trans  &kp LEFT_RING2_KEY              &trans              &trans         &trans                                                  &right_middy_tap KEY_RH_C1R3  &right_middy_tap KEY_RH_C2R3  &right_middy_tap KEY_RH_C3R3              &RightMiddyRing2  &right_middy_tap KEY_RH_C5R3  &right_middy_tap KEY_RH_C6R3
 &trans  &kp LEFT_PINKY_KEY  &kp LEFT_RING1_KEY  &kp LEFT_MIDDY_KEY  &kp LEFT_INDEX_KEY  &LeftPlainKey                                                  &right_middy_tap KEY_RH_C1R4              &RightMiddyIndex                         &none              &RightMiddyRing1              &RightMiddyPinky  &right_middy_tap KEY_RH_C6R4
 &trans              &trans              &trans              &trans              &trans         &trans  &trans  &trans  &trans  &trans  &trans  &trans  &right_middy_tap KEY_RH_C1R5  &right_middy_tap KEY_RH_C2R5  &right_middy_tap KEY_RH_C3R5  &right_middy_tap KEY_RH_C4R5  &right_middy_tap KEY_RH_C5R5  &right_middy_tap KEY_RH_C6R5
 &trans              &trans              &trans              &trans              &trans                 &trans  &trans  &trans  &trans  &trans  &trans                                &right_middy_tap KEY_RH_C2R6  &right_middy_tap KEY_RH_C3R6  &right_middy_tap KEY_RH_C4R6  &right_middy_tap KEY_RH_C5R6                        &trans
            >;
        };

        layer_RightIndex {
            bindings = <
 &trans              &trans              &trans              &trans              &trans                                                                                               &right_index_tap KEY_RH_C2R1  &right_index_tap KEY_RH_C3R1  &right_index_tap KEY_RH_C4R1  &right_index_tap KEY_RH_C5R1  &right_index_tap KEY_RH_C6R1
 &trans              &trans              &trans              &trans              &trans         &trans                                                  &right_index_tap KEY_RH_C1R2  &right_index_tap KEY_RH_C2R2  &right_index_tap KEY_RH_C3R2  &right_index_tap KEY_RH_C4R2  &right_index_tap KEY_RH_C5R2  &right_index_tap KEY_RH_C6R2
 &trans              &trans  &kp LEFT_RING2_KEY              &trans              &trans         &trans                                                  &right_index_tap KEY_RH_C1R3  &right_index_tap KEY_RH_C2R3  &right_index_tap KEY_RH_C3R3              &RightIndexRing2  &right_index_tap KEY_RH_C5R3  &right_index_tap KEY_RH_C6R3
 &trans  &kp LEFT_PINKY_KEY  &kp LEFT_RING1_KEY  &kp LEFT_MIDDY_KEY  &kp LEFT_INDEX_KEY  &LeftPlainKey                                                  &right_index_tap KEY_RH_C1R4                         &none              &RightIndexMiddy              &RightIndexRing1              &RightIndexPinky  &right_index_tap KEY_RH_C6R4
 &trans              &trans              &trans              &trans              &trans         &trans  &trans  &trans  &trans  &trans  &trans  &trans  &right_index_tap KEY_RH_C1R5  &right_index_tap KEY_RH_C2R5  &right_index_tap KEY_RH_C3R5  &right_index_tap KEY_RH_C4R5  &right_index_tap KEY_RH_C5R5  &right_index_tap KEY_RH_C6R5
 &trans              &trans              &trans              &trans              &trans                 &trans  &trans  &trans  &trans  &trans  &trans                                &right_index_tap KEY_RH_C2R6  &right_index_tap KEY_RH_C3R6  &right_index_tap KEY_RH_C4R6  &right_index_tap KEY_RH_C5R6                        &trans
            >;
        };

        layer_Cursor {
            bindings = <
     &none               &none               &none               &none               &none                                                                                                                             &none           &none           &none      &none        &none
   &kp ESC             &kp RET           &kp SPACE             &kp TAB             &kp DEL     &kp INS                                                                                                    &kp INS    &kp DEL         &kp TAB       &kp SPACE    &kp RET      &kp ESC
 &kp _C(K)           &sk LSHFT           &kp _REDO           &kp _UNDO            &kp BSPC    &kp _CUT                                                                                                  &kp _COPY   &kp BSPC       &kp _UNDO       &kp _REDO  &sk LSHFT    &kp _C(K)
 &kp _C(L)  &kp LEFT_PINKY_MOD  &kp LEFT_RING1_MOD  &kp LEFT_MIDDY_MOD  &kp LEFT_INDEX_MOD   &kp _COPY                                                                                                   &kp LEFT   &kp DOWN          &kp UP       &kp RIGHT    &kp RET    &kp _C(L)
 &kp _C(J)           &kp _C(A)        &select_line        &select_word           &kp _FIND  &kp _PASTE  &mod_tab _A_TAB  &mod_tab _G_TAB            &kp TAB  &select_none  &extend_line  &extend_word  &kp _PASTE   &kp HOME       &kp PG_UP       &kp PG_DN    &kp END    &kp _C(J)
 &kp _C(H)      &kp _FIND_PREV        &extend_line        &extend_word      &kp _FIND_NEXT                        &none    &mod_tab LCTL  &tog LAYER_Cursor     &kp _C(A)  &select_line  &select_word              &kp _FIND  &kp _FIND_PREV  &kp _FIND_NEXT  &kp _C(H)  &kp LG(DOT)
            >;
        };

        layer_Number {
            bindings = <
      &none               &none               &none               &none               &none                                                                                                                &none       &none       &none          &none      &none
    &kp ESC             &kp RET           &kp SPACE             &kp TAB             &kp DEL  &kp INS                                                                                       &kp CARET    &kp DLLR    &kp HASH      &kp AT       &kp EXCL   &kp PIPE
      &none           &sk LSHFT           &kp _REDO           &kp _UNDO            &kp BSPC    &kp A                                                                                       &kp PRCNT  &kp _KP_N7  &kp _KP_N8  &kp _KP_N9      &kp COLON      &kp K
 &kp KP_NUM  &kp LEFT_PINKY_MOD  &kp LEFT_RING1_MOD  &kp LEFT_MIDDY_MOD  &kp LEFT_INDEX_MOD    &kp B                                                                                    &kp _KP_PLUS  &kp _KP_N4  &kp _KP_N5  &kp _KP_N6  &kp _KP_MINUS      &kp J
      &none           &kp _C(A)        &select_line        &select_word           &kp UNDER    &kp C   &kp D   &kp E              &kp F         &kp LT       &kp GT  &kp _KP_EQUAL  &kp _KP_ASTERISK  &kp _KP_N1  &kp _KP_N2  &kp _KP_N3  &kp _KP_SLASH  &kp LS(G)
      &none               &none        &extend_line        &extend_word               &kp X            &none   &none  &tog LAYER_Number  &kp _KP_COMMA  &kp _KP_DOT     &kp _KP_N0                        &trans      &trans      &trans         &trans  &kp TILDE
            >;
        };

        layer_Function {
            bindings = <
    &none               &none               &none               &none               &none                                                                                                                  &none         &none         &none          &none      &win_sleep
  &kp ESC             &kp RET           &kp SPACE             &kp TAB             &kp DEL  &kp INS                                                                               &kp C_MEDIA_HOME     &kp C_PLAY    &kp C_PREV    &kp C_NEXT     &kp C_STOP     &kp C_EJECT
    &none           &sk LSHFT           &kp _REDO           &kp _UNDO            &kp BSPC    &none                                                                                      &kp K_WWW         &kp F7        &kp F8        &kp F9        &kp F10         &kp F13
 &kp CAPS  &kp LEFT_PINKY_MOD  &kp LEFT_RING1_MOD  &kp LEFT_MIDDY_MOD  &kp LEFT_INDEX_MOD    &none                                                                                     &kp K_CALC         &kp F4        &kp F5        &kp F6        &kp F11         &kp F14
    &none           &kp _C(A)        &select_line        &select_word               &none    &none   &none   &none                &none  &kp C_PREV    &kp C_NEXT      &kp C_PP    &kp C_AL_FILES         &kp F1        &kp F2        &kp F3        &kp F12         &kp F15
    &none               &none        &extend_line        &extend_word               &none            &none   &none  &tog LAYER_Function  &kp C_MUTE  &kp C_VOL_DN  &kp C_VOL_UP                    &kp C_BRI_MAX  &kp C_BRI_UP  &kp C_BRI_DN  &kp C_BRI_MIN  &kp C_BRI_AUTO
            >;
        };

        layer_Emoji {
            bindings = <
            &emoji_cloudy     &emoji_mostly_cloudy           &emoji_partly_cloudy        &emoji_mostly_sunny                  &emoji_sunny                                                                                                                                                                                                    &emoji_new_moon      &emoji_moon_crescent         &emoji_moon_quarter         &emoji_moon_gibbous         &emoji_full_moon
          &emoji_rainbow    &emoji_light_skin_tone  &emoji_medium_light_skin_tone    &emoji_medium_skin_tone  &emoji_medium_dark_skin_tone  &emoji_dark_skin_tone                                                                                                                                                     &emoji_tada                &emoji_heart               &emoji_fire               &emoji_muscle      &emoji_person_climbing          &emoji_lab_coat
        &emoji_left_arrow              &emoji_bald                &emoji_red_hair          &emoji_curly_hair             &emoji_white_hair     &emoji_right_arrow                                                                                                                                               &emoji_face_laugh           &emoji_face_smile          &emoji_face_eyes            &emoji_face_joke            &emoji_face_fear     &emoji_face_surprise
       &emoji_female_sign  &emoji_skin_tone_preset                     &emoji_zwj  &emoji_gender_sign_preset      &emoji_hair_style_preset       &emoji_male_sign                                                                                                                                        &emoji_gesture_attention     &emoji_gesture_approval  &emoji_gesture_gratitude      &emoji_gesture_anxiety      &emoji_gesture_despair   &emoji_gesture_curious
         &emoji_old_woman             &emoji_woman                    &emoji_girl                 &emoji_boy                    &emoji_man         &emoji_old_man  &emoji_cityscape  &emoji_cityscape_dusk  &emoji_cityscape_night      &emoji_astronaut         &emoji_rocket      &emoji_moon_stars  &emoji_person_tipping_hand  &emoji_person_gesturing_ok      &emoji_person_bowing  &emoji_person_raising_hand  &emoji_person_gesturing_no  &emoji_person_shrugging
 &emoji_sunrise_mountains           &emoji_sunrise                    &emoji_baby         &emoji_baby_bottle                         &none                                &kp LSHFT                  &none        &tog LAYER_Emoji  &emoji_gesture_hands  &emoji_gesture_point  &emoji_gesture_thumbs                                         &emoji_checkoff                &emoji_100              &emoji_warning                    &emoji_x          &emoji_question
            >;
        };

        layer_Symbol {
            bindings = <
      &email        &none       &none       &none      &none                                                                                                            &none                &none                &none                &none   &none
       &none  &base_grave   &kp _LPAR   &kp _RPAR  &kp _SEMI  &kp _COMMA                                                                           &none                &none                &none                &none                &none   &none
   &kp _EXCL    &kp _LBRC    &kp _SQT    &kp _DQT  &kp _RBRC  &kp _QMARK                                                                        &kp SEMI  &kp RIGHT_INDEX_MOD  &kp RIGHT_MIDDY_MOD  &kp RIGHT_RING1_MOD  &kp RIGHT_PINKY_MOD   &none
   &kp _HASH  &base_caret  &kp _EQUAL  &kp _UNDER  &kp _DLLR   &kp _STAR                                                                         &kp DOT             &kp BSPC              &kp TAB            &kp SPACE              &kp RET   &none
     &kp _AT      &kp _LT   &kp _PIPE  &kp _MINUS    &kp _GT   &kp _FSLH   &kp _BSLH    &kp _DOT  &kp _STAR              &none   &none   &none  &kp FSLH              &kp DEL          &kp LS(TAB)                &none                &none   &none
 &base_tilde    &kp _AMPS   &kp _LBKT   &kp _RBKT  &kp _PLUS              &kp _PRCNT  &kp _COLON  &kp _SEMI  &tog LAYER_Symbol   &none   &none                         &trans               &trans               &trans               &trans   &none
            >;
        };

        layer_Mouse {
            bindings = <
  &none   &none           &none           &none            &none                                                                                                   &none                &none                &none                &none   &none
  &none   &none           &none           &none            &none   &none                                                                      &none                &none                &none                &none                &none   &none
  &none   &none  &msc SCRL_LEFT    &mmv MOVE_UP  &msc SCRL_RIGHT   &none                                                                  &mkp MCLK  &kp RIGHT_INDEX_MOD  &kp RIGHT_MIDDY_MOD  &kp RIGHT_RING1_MOD  &kp RIGHT_PINKY_MOD   &none
  &none   &none  &mmv MOVE_LEFT  &mmv MOVE_DOWN  &mmv MOVE_RIGHT   &none                                                                  &mkp LCLK       &mmv MOVE_LEFT         &mmv MOVE_UP       &mmv MOVE_DOWN      &mmv MOVE_RIGHT   &none
  &none   &none           &none  &msc SCRL_DOWN     &msc SCRL_UP   &none  &mkp MCLK      &none   &none             &none   &none   &none  &mkp RCLK       &msc SCRL_LEFT         &msc SCRL_UP       &msc SCRL_DOWN      &msc SCRL_RIGHT   &none
  &none   &none           &none           &none            &none          &mkp LCLK  &mkp RCLK   &none  &tog LAYER_Mouse   &none   &none                           &none                &none                &none                &none   &none
            >;
        };

        layer_System {
            bindings = <
           &none            &none            &none            &none            &none                                                                                                                                   &none                &none                &none                &none            &none
           &none            &none            &none            &none            &none      &none                                                                                                   &none                &none                &none                &none                &none            &none
           &none            &none  &rgb_ug RGB_HUD  &rgb_ug RGB_HUI            &none      &none                                                                                         &rgb_ug RGB_SAI  &kp RIGHT_INDEX_MOD  &kp RIGHT_MIDDY_MOD  &kp RIGHT_RING1_MOD  &kp RIGHT_PINKY_MOD  &rgb_ug RGB_SAD
 &rgb_ug RGB_TOG  &rgb_ug RGB_EFR  &rgb_ug RGB_BRD  &rgb_ug RGB_BRI  &rgb_ug RGB_EFF  &kp K_APP                                                                                         &rgb_ug RGB_HUI            &kp K_APP            &kp _LOCK           &kp _SLEEP           &kp _POWER  &rgb_ug RGB_HUD
           &none  &rgb_ug RGB_SPD  &rgb_ug RGB_SAD  &rgb_ug RGB_SAI  &rgb_ug RGB_SPI      &none  &kp _LOCK  &kp _SLEEP       &kp _POWER              &none   &none               &none  &rgb_ug RGB_SPI      &rgb_ug RGB_TOG            &kp PSCRN             &kp SLCK      &kp PAUSE_BREAK  &rgb_ug RGB_SPD
           &none            &none            &none            &none            &none             &kp PSCRN    &kp SLCK  &kp PAUSE_BREAK  &tog LAYER_System   &none  &linux_magic_sysrq                       &rgb_ug RGB_EFF      &rgb_ug RGB_BRI      &rgb_ug RGB_BRD      &rgb_ug RGB_EFR            &none
            >;
        };

        layer_World {
            bindings = <
                &none                    &none                  &none                 &none                     &none                                                                                          &none      &none      &none      &none   &none
                &none                    &none                  &none                 &none                     &none   &none                                                                       &none      &none      &none      &none      &none   &none
                &none       &world_degree_sign          &world_y_base         &world_o_base             &world_u_base   &none                                                                       &none      &none   &kp LALT   &kp RALT      &none   &none
                &none   &world_consonants_base          &world_i_base         &world_e_base             &world_a_base   &none                                                                       &none  &kp LSHFT  &kp LCTRL  &kp RCTRL  &kp RSHFT   &none
 &world_currency_base  &world_quotes_left_base    &world_exclaim_left  &world_question_left  &world_quotes_right_base   &none   &none   &none             &none             &none   &none   &none   &none      &none      &none      &none      &none   &none
    &world_micro_sign      &world_section_sign  &world_paragraph_sign      &world_o_ordinal          &world_a_ordinal           &none   &none  &tog LAYER_World  &tog LAYER_World   &none   &none              &none      &none      &none      &none   &none
            >;
        };

        layer_Gaming {
            bindings = <
    &trans     &trans  &trans  &trans  &trans                                                                                             &trans  &trans     &trans   &trans    &trans
    &trans     &trans  &trans  &trans  &trans   &trans                                                                            &trans  &trans  &trans     &trans   &trans    &trans
 &kp MINUS  &kp GRAVE   &kp B   &kp N   &kp M  &kp SQT                                                                             &kp B   &kp N   &kp M  &kp COMMA  &kp DOT  &kp FSLH
     &kp T    &kp TAB   &kp Q   &kp W   &kp E    &kp R                                                                             &kp T   &kp Y   &kp U      &kp I    &kp O     &kp P
     &kp G  &kp LSHFT   &kp A   &kp S   &kp D    &kp F    &kp ESC   &kp RET  &kp PAUSE_BREAK           &kp BSPC  &kp DEL  &trans   &kp G   &kp H   &kp J      &kp K    &kp L  &kp SEMI
     &kp V  &kp LCTRL   &kp Z   &kp X   &kp C           &kp SPACE  &kp LALT         &kp LGUI  &tog LAYER_Gaming   &trans  &trans          &trans  &trans     &trans   &trans    &trans
            >;
        };

        layer_Factory {
            bindings = <
               &kp F1    &kp F2   &kp F3    &kp F4     &kp F5                                                                                  &kp F6     &kp F7    &kp F8    &kp F9    &kp F10
            &kp EQUAL    &kp N1   &kp N2    &kp N3     &kp N4  &kp N5                                                                  &kp N6  &kp N7     &kp N8    &kp N9    &kp N0  &kp MINUS
              &kp TAB     &kp Q    &kp W     &kp E      &kp R   &kp T                                                                   &kp Y   &kp U      &kp I     &kp O     &kp P   &kp BSLH
              &kp ESC     &kp A    &kp S     &kp D      &kp F   &kp G                                                                   &kp H   &kp J      &kp K     &kp L  &kp SEMI    &kp SQT
            &kp GRAVE     &kp Z    &kp X     &kp C      &kp V   &kp B  &kp LSHFT  &kp LCTRL    &lower  &kp LGUI  &kp RCTRL  &kp RSHFT   &kp N   &kp M  &kp COMMA   &kp DOT  &kp FSLH  &kp PG_UP
 &magic LAYER_Magic 0  &kp HOME  &kp END  &kp LEFT  &kp RIGHT           &kp BSPC    &kp DEL  &kp LALT  &kp RALT    &kp RET  &kp SPACE          &kp UP   &kp DOWN  &kp LBKT  &kp RBKT  &kp PG_DN
            >;
        };

        layer_Lower {
            bindings = <
         &kp C_BRI_DN  &kp C_BRI_UP      &kp C_PREV      &kp C_NEXT          &kp C_PP                                                                                                                                                    &kp C_MUTE  &kp C_VOL_DN  &kp C_VOL_UP            &none       &kp PAUSE_BREAK
            &kp EQUAL         &none           &none           &none             &none   &kp HOME                                                                                                                         &kp LPAR        &kp KP_NUM  &kp KP_EQUAL  &kp KP_SLASH  &kp KP_MULTIPLY       &kp PRINTSCREEN
              &kp TAB         &none           &none    &kp UP_ARROW             &none    &kp END                                                                                                                         &kp RPAR         &kp KP_N7     &kp KP_N8     &kp KP_N9     &kp KP_MINUS        &kp SCROLLLOCK
              &kp ESC         &none  &kp LEFT_ARROW  &kp DOWN_ARROW   &kp RIGHT_ARROW  &kp PG_UP                                                                                                                      &kp PERCENT         &kp KP_N4     &kp KP_N5     &kp KP_N6      &kp KP_PLUS            &kp KP_NUM
            &kp GRAVE     &kp K_APP           &none         &kp F11           &kp F12  &kp PG_DN  &tog LAYER_Function  &tog LAYER_Typing  &tog LAYER_Gaming  &tog LAYER_Gaming  &tog LAYER_Typing  &tog LAYER_System    &kp COMMA         &kp KP_N1     &kp KP_N2     &kp KP_N3     &kp KP_ENTER              &kp LALT
 &magic LAYER_Magic 0      &kp CAPS         &kp INS         &kp F11  &tog LAYER_Emoji               &tog LAYER_Cursor  &tog LAYER_Number   &tog LAYER_Lower   &tog LAYER_Lower   &tog LAYER_Mouse  &tog LAYER_Symbol               &tog LAYER_World     &kp KP_N0    &kp KP_DOT     &kp KP_ENTER  &magic LAYER_Magic 0
            >;
        };

        layer_Magic {
            bindings = <
  &bt BT_CLR            &none            &none            &none            &none                                                                                  &none   &none   &none   &none  &bt BT_CLR_ALL
       &to 0            &to 1            &to 2            &to 3            &to 4            &to 5                                                         &to 6   &to 7   &to 8   &none   &none           &none
       &none  &rgb_ug RGB_SPI  &rgb_ug RGB_SAI  &rgb_ug RGB_HUI  &rgb_ug RGB_BRI  &rgb_ug RGB_TOG                                                         &none   &none   &none   &none   &none           &none
 &bootloader  &rgb_ug RGB_SPD  &rgb_ug RGB_SAD  &rgb_ug RGB_HUD  &rgb_ug RGB_BRD  &rgb_ug RGB_EFF                                                         &none   &none   &none   &none   &none     &bootloader
  &sys_reset            &none            &none            &none            &none            &none   &bt_2   &bt_3       &tog 29   &none   &none   &none   &none   &none   &none   &none   &none      &sys_reset
       &none            &none            &none            &none            &none                    &bt_0   &bt_1  &out OUT_USB   &none   &none   &none           &none   &none   &none   &none           &none
            >;
        };

    };
};
